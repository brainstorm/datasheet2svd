# V850 register map
Vendor: Renesas; Series: E1/E2/CA2; File version: 1.2
CPU: V850 r1, LE endian
Registers are 6-bit, read-write, reset 0x0 unless marked. A register's access mark holds for its fields unless they carry their own. Offsets are from the block's base; [hi:lo] are bit positions; {n}, {i} and the like mark numbered series.

## mmio — Memory Mapped IO, peripherals
Base 0xFFFFF000
0xFFFFF002 PAH 8-bit — Port AH
0xFFFFF008 PCS 8-bit — Port CS
0xFFFFF00A PCT 8-bit — Port CT
0xFFFFF00C PCM 8-bit — Port CM
0xFFFFF022 PMAH 8-bit — Port AH mode
0xFFFFF028 PMCS 8-bit — Port CS mode
0xFFFFF02A PMCT 8-bit — Port CT mode
0xFFFFF02C PMCM 8-bit — Port CM mode
0xFFFFF042 PMCAH 8-bit — Port AH mode control
0xFFFFF048 PMCCS 8-bit — Port CS mode control
0xFFFFF04A PMCCT 8-bit — Port CT mode control
0xFFFFF04C PMCCM 8-bit — Port CM mode control
0xFFFFF060 CSC0 16-bit — CPU: Chip Area Select Control register 0
0xFFFFF062 CSC1 16-bit — CPU: Chip Area Select Control register 1
0xFFFFF064 BPC 16-bit — CPU: Peripheral Area Select Control register
0xFFFFF066 BSC 16-bit — CPU: Bus Size Configuration register
0xFFFFF068 BEC 16-bit — CPU: Endian Configuration register
0xFFFFF06A BHC 16-bit — CPU: Cache Configuration register
0xFFFFF06E VSWC 8-bit — CPU: VPB Strobe Wait Control register
0xFFFFF070 ICC 16-bit — Instruction Cache Control Register
0xFFFFF072 ICI 16-bit — Instruction Cache Index Register
0xFFFFF074 ICD 16-bit — Instruction Cache Data Configuration
{0xFFFFF080+8i} DSAL{i} 16-bit (i=0..3) — DMA source address register {i}L
{0xFFFFF082+8i} DSAH{i} 16-bit (i=0..3) — DMA source address register {i}H
{0xFFFFF084+8i} DDAL{i} 16-bit (i=0..3) — DMA destination address register {i}L
{0xFFFFF086+8i} DDAH{i} 16-bit (i=0..3) — DMA destination address register {i}H
{0xFFFFF0C0+2i} DBC{i} 16-bit (i=0..3) — DMA transfer count register {i}
{0xFFFFF0D0+2i} DADC{i} 16-bit (i=0..3) — DMA addressing control register {i}
{0xFFFFF0E0+2i} DCHC{i} 8-bit (i=0..3) — DMA channel control register {i}
0xFFFFF0F0 DDIS 8-bit ro — DMA disable status register
0xFFFFF0F2 DRST 8-bit — DMA restart register
{0xFFFFF100+2i} IMR{i} 16-bit (i=0..3) — Interrupt Mask register {i}
0xFFFFF110 WTIC 8-bit — Interrupt control register 0
0xFFFFF112 TMD0IC 8-bit — Interrupt control register 1
0xFFFFF114 TMD1IC 8-bit — Interrupt control register 2
0xFFFFF116 WTIIC 8-bit — Interrupt control register 3
0xFFFFF118 P0IC 8-bit — Interrupt control register 4
{0xFFFFF118+2i} P{i}IC 8-bit (i=1..5) — Interrupt control register {i+4}
0xFFFFF124 TMG00IC 8-bit — Interrupt control register 10
0xFFFFF126 TMG01IC 8-bit — Interrupt control register 11
0xFFFFF128 CCG00 IC 8-bit — Interrupt control register 12
{0xFFFFF128+2i} CCG{i:02}IC 8-bit (i=1..5) — Interrupt control register {i+12}
0xFFFFF134 TMG10IC 8-bit — Interrupt control register 18
0xFFFFF136 TMG11IC 8-bit — Interrupt control register 19
0xFFFFF138 CCG10 IC 8-bit — Interrupt control register 20
{0xFFFFF124+2i} CCG{i}IC 8-bit (i=11..15) — Interrupt control register {i+10}
0xFFFFF144 TMC0IC 8-bit — Interrupt control register 26
0xFFFFF146 CCC0 IC 8-bit — Interrupt control register 27
0xFFFFF148 CCC1IC 8-bit — Interrupt control register 28
0xFFFFF14A ADIC 8-bit — Interrupt control register 29
0xFFFFF14C MACIC 8-bit — Interrupt control register 30
{0xFFFFF148+6i} FC{i}RXIC 8-bit (i=1..4) — Interrupt control register {3i+28}
{0xFFFFF14A+6i} FC{i}TXIC 8-bit (i=1..4) — Interrupt control register {3i+29}
{0xFFFFF14C+6i} FC{i}ERIC 8-bit (i=1..4) — Interrupt control register {3i+30}
{0xFFFFF166+2i} CSI{i}IC 8-bit (i=0..2) — Interrupt control register {i+43}
0xFFFFF16C SER0IC 8-bit — Interrupt control register 46
0xFFFFF16E SR0IC 8-bit — Interrupt control register 47
0xFFFFF170 ST0IC 8-bit — Interrupt control register 48
0xFFFFF172 SER1IC 8-bit — Interrupt control register 49
0xFFFFF174 SR1IC 8-bit — Interrupt control register 50
0xFFFFF176 ST1IC 8-bit — Interrupt control register 51
{0xFFFFF178+2i} DMA{i}IC 8-bit (i=0..3) — Interrupt control register {i+52}
0xFFFFF180 DOVFIC 8-bit — Interrupt control register 56
0xFFFFF182 P00IC 8-bit — Interrupt control register 57
0xFFFFF184 P05IC 8-bit — Interrupt control register 58
0xFFFFF186 P10IC 8-bit — Interrupt control register 59
0xFFFFF188 P15IC 8-bit — Interrupt control register 60
0xFFFFF18A P20IC 8-bit — Interrupt control register 61
0xFFFFF18C P21IC 8-bit — Interrupt control register 62
0xFFFFF18E Reserved 8-bit — Interrupt control register 63
0xFFFFF1FA ISPR 8-bit ro — In-service Priority register
0xFFFFF1FC PRCMD 8-bit wo — Command register
0xFFFFF1FE PSC 8-bit — Power Save Control register
0xFFFFF200 ADM 8-bit — A/D converter mode register
0xFFFFF201 ADS 8-bit — A/D Select Register
0xFFFFF202 ADCR 16-bit ro — A/D Conversion Result Register
0xFFFFF203 ADCRH 8-bit ro — A/D Conversion Result Register H
{0xFFFFF3FE+2i} P{i} 8-bit (i=1..6) — Port {i}
0xFFFFF40C P7 8-bit ro — Port 7
0xFFFFF40C P78 16-bit ro — Port 7/Port 8
0xFFFFF40E P9 8-bit — Port 9
{0xFFFFF41E+2i} PM{i} 8-bit (i=1..6) — Port {i} mode
0xFFFFF42E PM9 8-bit — Port 9 mode
{0xFFFFF43E+2i} PMC{i} 8-bit (i=1..6) — Port {i} mode control
0xFFFFF480 BCT0 16-bit — MEMC: Bus Cycle Type Control register 0
0xFFFFF482 BCT1 16-bit — MEMC: Bus Cycle Type Control register 1
0xFFFFF484 DWC0 16-bit — MEMC: Data Wait Control register 0
0xFFFFF486 DWC1 16-bit — MEMC: Data Wait Control register 1
0xFFFFF488 BCC 16-bit — MEMC: Bus Cycle Control register
0xFFFFF48A ASC 16-bit — MEMC: Address Setup Wait Control Reg.
0xFFFFF49A PRC 16-bit — MEMC: Page-ROM Configuration register
0xFFFFF540 TMD0 16-bit ro — Timer D0 counter
0xFFFFF542 CMD0 16-bit — Timer D0 compare register
0xFFFFF544 TMCD0 8-bit — Timer D0 Control register
0xFFFFF550 TMD1 16-bit ro — Timer D1 counter
0xFFFFF552 CMD1 16-bit — Timer D1 compare register
0xFFFFF554 TMCD1 8-bit — Timer D1 Control register
0xFFFFF560 WTM 8-bit — Watch timer mode register
0xFFFFF571 WDCS 8-bit — Watchdog timer time select register
0xFFFFF572 WDTM 8-bit — Watchdog timer mode register
0xFFFFF580 WCMD 8-bit wo — Watchdog Timer command register
0xFFFFF582 WPHS 8-bit — Watchdog Timer command status register
0xFFFFF600 TMC0 16-bit ro — Timer C0 timer counter register
0xFFFFF602 CCC00 16-bit — Timer C0 capture compare register 0
0xFFFFF604 CCC01 16-bit — Timer C0 capture compare register 1
0xFFFFF606 TMCC00 8-bit — Timer C0 control register 0
0xFFFFF608 TMCC01 8-bit — Timer C0 control register 1
0xFFFFF609 SESC0 8-bit — Timer C0 signal edge select register
0xFFFFF640 TMGM0 16-bit — Timer mode register 0
0xFFFFF640 TMGM0L 8-bit — Timer mode register 0 low
0xFFFFF641 TMGM0H 8-bit — Timer mode register 0 high
0xFFFFF642 TMGCM0 16-bit — Channel mode register 0
0xFFFFF642 TMGCM0L 8-bit — Channel mode register 0 low
0xFFFFF643 TMGCM0H 8-bit — Channel mode register 0 high
0xFFFFF644 OCTLG0 16-bit — Output control register 0
0xFFFFF644 OCTLG0L 8-bit — Output control register 0 low
0xFFFFF645 OCTLG0H 8-bit — Output control register 0 high
0xFFFFF646 TMGST0 8-bit ro — State register 0
0xFFFFF648 TMG00 16-bit ro — Timer Count Register 00
0xFFFFF64A TMG01 16-bit ro — Timer Count Register 01
{0xFFFFF64C+2i} GCC{i:02} 16-bit (i=0..5) — Capture/Compare register {i:02}
0xFFFFF680 TMGM1 16-bit — Timer mode register 1
0xFFFFF680 TMGM1L 8-bit — Timer mode register 1 low
0xFFFFF681 TMGM1H 8-bit — Timer mode register 1 high
0xFFFFF682 TMGCM1 16-bit — Channel mode register 1
0xFFFFF683 TMGCM1L 8-bit — Channel mode register 1 low
0xFFFFF683 TMGCM1H 8-bit — Channel mode register 1 high
0xFFFFF684 OCTLG1 16-bit — Output control register 1
0xFFFFF684 OCTLG1L 8-bit — Output control register 1 low
0xFFFFF685 OCTLG1H 8-bit — Output control register 1 high
0xFFFFF686 TMGST1 8-bit ro — State register 1
0xFFFFF688 TMG10 16-bit ro — Timer Count Register 10
0xFFFFF68A TMG11 16-bit ro — Timer Count Register 11
{0xFFFFF678+2i} GCC{i} 16-bit (i=10..15) — Capture/Compare register {i}
0xFFFFF800 PHCMD 8-bit wo — Peripheral command register
0xFFFFF802 PHS 8-bit — Peripheral status register
0xFFFFF820 PSM 8-bit — Power save mode register
0xFFFFF822 CKC 8-bit — Clock control register
0xFFFFF824 CGSTAT 8-bit ro — Clock generator status register
0xFFFFF826 WCC 8-bit — Watch dog clock control register
0xFFFFF828 PCC 8-bit — Processor clock control register
0xFFFFF82A SCFMC 8-bit — Frequency modulation control register
0xFFFFF82C SCFC0 8-bit — Frequency control 0
0xFFFFF82E SCFC1 8-bit — Frequency control 1
0xFFFFF830 RSM 8-bit — Reset source monitor register
{0xFFFFF840+2i} DTFR{i} 8-bit (i=0..3) — DMA trigger source select register {i}
{0xFFFFF880+2i} INTM{i} 8-bit (i=0..3) — Interrupt Mode Control Register {i}
0xFFFFFA00 ASIM0 8-bit — UART operation mode register 0
0xFFFFFA02 RXB0 8-bit ro — Reception buffer register 0
0xFFFFFA03 ASIS0 8-bit ro — UART reception error status register 0
0xFFFFFA04 TXB0 8-bit — Transmission buffer register 0
0xFFFFFA05 ASIF0 8-bit ro — UART transmission error status register 0
0xFFFFFA06 CHKSR0 8-bit — Clock selection register CHKSR0
0xFFFFFA07 BRGC0 8-bit — Baudrate definition register 0
0xFFFFFA40 ASIM1 8-bit — UART operation mode register 1
0xFFFFFA42 RXB1 8-bit ro — Reception buffer register 1
0xFFFFFA43 ASIS1 8-bit ro — UART reception error status register 1
0xFFFFFA44 TXB1 8-bit — Transmission buffer register 1
0xFFFFFA45 ASIF1 8-bit ro — UART transmission error status register 1
0xFFFFFA46 CHKSR1 8-bit — Clock selection register 1
0xFFFFFA47 BRGC1 8-bit — Baudrate definition register 1
{0xFFFFFD00+0x40*i} CSIM{i} 8-bit (i=0..2) — CSI operation mode register {i}
{0xFFFFFD01+0x40*i} CSIC{i} 8-bit (i=0..2) — Clock selection register CSIC{i}
{0xFFFFFD02+0x40*i} SIRB{i}/SIRBL{i} 16-bit ro (i=0..2) — Reception data buffer register {i}
{0xFFFFFD04+0x40*i} SOTB{i}/SOTBL{i} 16-bit (i=0..2) — Transmission data buffer register {i}
{0xFFFFFD08+0x40*i} SOTBF{i}/SOTBFL{i} 16-bit (i=0..2) — First transmission data buffer register {i}
0xFFFFFD0A SIO0/SIOL0 16-bit ro — Shift register
0xFFFFFD4A SIO1/SIOL1 16-bit ro — Shift register 1
0xFFFFFD8A SIO2/SIOL2 16-bit ro — Shift register 2
0xFFFFFDC0 PRSM0 8-bit — BRG0 Prescaler mode register 0
0xFFFFFDC1 PRSCM0 8-bit — BRG0 Prescaler compare register 0
0xFFFFFDE0 PRSM1 8-bit — BRG1 Prescaler mode register 1
0xFFFFFDE1 PRSCM1 8-bit — BRG1 Prescaler compare register 1
