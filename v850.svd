# V850 register map
Vendor: Renesas; Series: E1/E2/CA2; File version: 1.2
NEC/Renesas V850 automotive grade ICs
CPU: V850 r1, LE endian
Registers are 6-bit, read-write, reset 0x0 unless marked. A register's access mark holds for its fields unless they carry their own. Offsets are from the block's base; lines under a group give offsets from that group; [hi:lo] are bit positions; {n}, {i} and the like mark numbered series; 'fields as' and 'values as' point back to an identical list; <NAME> marks a mode.

## Memory map
0x00000000 irq size 0x470 — Interrupts and exception table
0xFFFFF000 mmio — Memory Mapped IO, peripherals
0xFFFFF000 pmmio — Memory Mapped IO, peripherals

## irq — Interrupts and exception table
Base 0x00000000
0x00 RESET input 16-bit
0x10 P60 NMI Input 16-bit
0x20 Watchdog timer 16-bit
0x40 TRAP instruction (0x40) 16-bit
0x50 TRAP instruction (0x50) 16-bit
0x60 Illegal opcode/DBTRAP instruction 16-bit
0x80 Real Time Clock Divider Tick 16-bit
0x90 Compare Match (0x90) 16-bit
0xA0 Compare Match (0xA0) 16-bit
0xB0 Interval time 16-bit
0xC0 P61 16-bit
0xD0 P62 16-bit
0xE0 P63 16-bit
0xF0 P64 16-bit
0x100 P52 16-bit
0x110 P53 16-bit
0x120 Time base 0 Overflow (0x120) 16-bit
0x130 Time base 1 Overflow (0x130) 16-bit
0x140 CC coincidence Channel 0 (0x140) 16-bit
0x150 CC coincidence Channel 1 (0x150) 16-bit
0x160 CC coincidence Channel 2 (0x160) 16-bit
0x170 CC coincidence Channel 3 (0x170) 16-bit
0x180 CC coincidence Channel 4 (0x180) 16-bit
0x190 CC coincidence Channel 5 (0x190) 16-bit
0x1A0 Time base 0 Overflow (0x1A0) 16-bit
0x1B0 Time base 1 Overflow (0x1B0) 16-bit
0x1C0 CC coincidence Channel 0 (0x1C0) 16-bit
0x1D0 CC coincidence Channel 1 (0x1D0) 16-bit
0x1E0 CC coincidence Channel 2 (0x1E0) 16-bit
0x1F0 CC coincidence Channel 3 (0x1F0) 16-bit
0x200 CC coincidence Channel 4 (0x200) 16-bit
0x210 CC coincidence Channel 5 (0x210) 16-bit
0x220 Time base Overflow 16-bit
0x230 CC coincidence Channel 0 16-bit
0x240 CC coincidence Channel 1 16-bit
0x250 A/D conversion end 16-bit
0x260 MAC Interrupt CGINTP 1 to 2 16-bit
{0x240+0x30*i} CAN{i} Receive Interrupt 16-bit (i=1..4)
{0x250+0x30*i} CAN{i} Transmit Interrupt 16-bit (i=1..4)
{0x260+0x30*i} CAN{i} Error Interrupt 16-bit (i=1..4)
{0x330+0x10*i} Transmission Reception Completion CSI{i} 16-bit (i=0..2)
0x360 Reception Error UART50 16-bit
0x370 Reception Completion UART50 16-bit
0x380 Transmission Completion UART50 16-bit
0x390 Reception Error UART51 16-bit
0x3A0 Reception Completion UART51 16-bit
0x3B0 Transmission Completion UART51 16-bit
{0x3C0+0x10*i} DMA Channel {i} transfer completed 16-bit (i=0..3)
0x400 DMA Overflow 16-bit
0x410 P30 16-bit
0x420 P35 16-bit
0x430 P40 16-bit
0x440 P45 16-bit
0x450 P54 16-bit
0x460 P55 16-bit
