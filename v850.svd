# V850 register map
Vendor: Renesas; Series: E1/E2/CA2; File version: 1.2
CPU: V850 r1, LE endian
Registers are 6-bit, read-write, reset 0x0 unless marked. A register's access mark holds for its fields unless they carry their own. Offsets are from the block's base; [hi:lo] are bit positions; {n}, {i} and the like mark numbered series.

## pmmio — Memory Mapped IO, peripherals
Base 0xFFFFF000
0x18000000 M_EVT000 8-bit — CAN message event pointer 000
{0x18000000+i} M_EVT{i:03} (i=1..3) — CAN message event pointer {i:03}
{0x18000004+0x20*i} M_DLC{i:02} (i=0..31) — CAN message data length register {i:02}
{0x18000005+0x20*i} M_CTRL{i:02} (i=0..4) — CAN message control register {i:02}
{0x18000006+0x20*i} M_TIME{i:02} (i=0..31) — CAN message time stamp register {i:02}
{0x18000008+i} M_DATA{i:03} (i=0..7) — CAN message data register {i:03}
{0x18000010+0x20*i} M_IDL{i:02} (i=0..30) — CAN message ID register L{i:02}
{0x18000012+0x20*i} M_IDH{i:02} (i=0..31) — CAN message ID register H{i:02}
{0x18000014+0x20*i} M_CONF{i:02} (i=0..31) — CAN message configuration register {i:02}
{0x18000015+0x20*i} M_STAT{i:02} ro (i=0..31) — CAN message status register {i:02}
{0x18000016+0x20*i} SC_STAT{i:02} wo (i=0..3) — CAN status set/cancel register {i:02}
{0x18000016+i} M_EVT{i:03} (i=10..13) — CAN message event pointer {i:03}
{0x1800001E+i} M_DATA{i:03} (i=10..17) — CAN message data register {i:03}
{0x1800002C+i} M_EVT{i:03} (i=20..23) — CAN message event pointer {i:03}
{0x18000034+i} M_DATA{i:03} (i=20..27) — CAN message data register {i:03}
{0x18000042+i} M_EVT{i:03} (i=30..33) — CAN message event pointer {i:03}
{0x1800004A+i} M_DATA{i:03} (i=30..37) — CAN message data register {i:03}
{0x18000058+i} M_EVT{i:03} (i=40..43) — CAN message event pointer {i:03}
{0x18000060+i} M_DATA{i:03} (i=40..47) — CAN message data register {i:03}
0x18000096 M_STAT04 wo — CAN status set/cancel register 04
{0x1800006E+i} M_EVT{i:03} (i=50..53) — CAN message event pointer {i:03}
0x180000A5 M_DTRL05 — CAN message control register 05
{0x18000076+i} M_DATA{i:03} (i=50..57) — CAN message data register {i:03}
{0x18000016+0x20*i} SC_STAT{i:02} wo (i=5..30) — CAN status set/cancel register {i:02}
{0x18000084+i} M_EVT{i:03} (i=60..63) — CAN message event pointer {i:03}
0x180000C5 M_DTRL06 — CAN message control register 06
{0x1800008C+i} M_DATA{i:03} (i=60..67) — CAN message data register {i:03}
{0x1800009A+i} M_EVT{i:03} (i=70..73) — CAN message event pointer {i:03}
{0x18000005+0x20*i} M_CTRL{i:02} (i=7..31) — CAN message control register {i:02}
{0x180000A2+i} M_DATA{i:03} (i=70..77) — CAN message data register {i:03}
{0x180000B0+i} M_EVT{i:03} (i=80..83) — CAN message event pointer {i:03}
{0x180000B8+i} M_DATA{i:03} (i=80..87) — CAN message data register {i:03}
{0x180000C6+i} M_EVT{i:03} (i=90..93) — CAN message event pointer {i:03}
{0x180000CE+i} M_DATA{i:03} (i=90..97) — CAN message data register {i:03}
{0x180000DC+i} M_EVT{i} (i=100..102) — CAN message event pointer {i}
0x18000143 M_EVT103 — CAN message event pointer103
{0x180000E4+i} M_DATA{i} (i=100..107) — CAN message data register {i}
0x18000160 M_EVT110 — CAN message event pointer 110
0x18000161 M_EVT111 — CAN message event pointer111
0x18000162 M_EVT112 — CAN message event pointer 112
0x18000163 M_EVT113 — CAN message event pointer 113
{0x180000FA+i} M_DATA{i} (i=110..117) — CAN message data register {i}
{0x18000108+i} M_EVT{i} (i=120..123) — CAN message event pointer {i}
{0x18000110+i} M_DATA{i} (i=120..127) — CAN message data register {i}
{0x1800011E+i} M_EVT{i} (i=130..133) — CAN message event pointer {i}
{0x18000126+i} M_DATA{i} (i=130..137) — CAN message data register {i}
{0x18000134+i} M_EVT{i} (i=140..143) — CAN message event pointer {i}
{0x1800013C+i} M_DATA{i} (i=140..147) — CAN message data register {i}
{0x1800014A+i} M_EVT{i} (i=150..153) — CAN message event pointer {i}
{0x18000152+i} M_DATA{i} (i=150..157) — CAN message data register {i}
{0x18000160+i} M_EVT{i} (i=160..163) — CAN message event pointer {i}
{0x18000168+i} M_DATA{i} (i=160..167) — CAN message data register {i}
{0x18000176+i} M_EVT{i} (i=170..173) — CAN message event pointer {i}
{0x1800017E+i} M_DATA{i} (i=170..177) — CAN message data register {i}
0x1800022A M_EVT212 — CAN message event pointer 212
{0x1800018C+i} M_EVT{i} (i=180..183) — CAN message event pointer {i}
{0x18000194+i} M_DATA{i} (i=180..187) — CAN message data register {i}
0x18000260 M_EVT260 — CAN message event pointer 260 (0x260)
0x18000261 M_EVT261 — CAN message event pointer 261 (0x261)
0x18000262 M_EVT262 — CAN message event pointer 262 (0x262)
0x18000263 M_EVT263 — CAN message event pointer 263 (0x263)
{0x180001AA+i} M_DATA{i} (i=190..197) — CAN message data register {i}
{0x180001B8+i} M_EVT{i} (i=200..203) — CAN message event pointer {i}
{0x180001C0+i} M_DATA{i} (i=200..207) — CAN message data register {i}
0x180002A0 M_EVT210 — CAN message event pointer 210
0x180002A1 M_EVT211 — CAN message event pointer 211
0x180002A3 M_EVT213 — CAN message event pointer 213
{0x180001D6+i} M_DATA{i} (i=210..217) — CAN message data register {i}
{0x180001E4+i} M_EVT{i} (i=220..223) — CAN message event pointer {i}
{0x180001EC+i} M_DATA{i} (i=220..227) — CAN message data register {i}
{0x180001FA+i} M_EVT{i} (i=230..233) — CAN message event pointer {i}
{0x18000202+i} M_DATA{i} (i=230..237) — CAN message data register {i}
{0x18000210+i} M_EVT{i} (i=240..243) — CAN message event pointer {i}
{0x18000218+i} M_DATA{i} (i=240..247) — CAN message data register {i}
{0x18000226+i} M_EVT{i} (i=250..253) — CAN message event pointer {i}
{0x1800022E+i} M_DATA{i} (i=250..257) — CAN message data register {i}
0x18000340 M_EVT260 — CAN message event pointer 260 (0x340)
0x18000341 M_EVT261 — CAN message event pointer 261 (0x341)
0x18000342 M_EVT262 — CAN message event pointer 262 (0x342)
0x18000343 M_EVT263 — CAN message event pointer 263 (0x343)
{0x18000244+i} M_DATA{i} (i=260..267) — CAN message data register {i}
{0x18000252+i} M_EVT{i} (i=270..273) — CAN message event pointer {i}
{0x1800025A+i} M_DATA{i} (i=270..277) — CAN message data register {i}
{0x18000268+i} M_EVT{i} (i=280..283) — CAN message event pointer {i}
{0x18000270+i} M_DATA{i} (i=280..287) — CAN message data register {i}
{0x1800027E+i} M_EVT{i} (i=290..293) — CAN message event pointer {i}
{0x18000286+i} M_DATA{i} (i=290..297) — CAN message data register {i}
{0x18000294+i} M_EVT{i} (i=300..303) — CAN message event pointer {i}
{0x1800029C+i} M_DATA{i} (i=300..307) — CAN message data register {i}
{0x180002AA+i} M_EVT{i} (i=310..313) — CAN message event pointer {i}
{0x180002B2+i} M_DATA{i} (i=310..317) — CAN message data register {i}
0x180003F7 SC_STAT31 wo — CAN status set/cancel register 31
0x180003FC M_IDL31 — CAN message ID register L31
0x18001000 CSTOP R/(W) — CAN stop register
0x18001004 CCINTP ro — CAN interrupt pending register
0x18001010 CGST R/(W) — CAN global status register
0x18001012 CGIE R/(W) — CAN global interrupt enable register
0x18001014 CGCS — CAN main clock select register
0x18001016 CGTEN — CAN timer event enable register
0x18001018 CGTSC ro — CAN time stop count register
0x1800101A CGMSS wo — CAN message find start register
0x1800101A CGMSR ro — CAN message find result register
0x1800101C CTBR — CAN test bus register
0x1800101D CGREV ro — CAN Macro Version Register
0x1800101E CGVER ro — CAN Macro Revision Register (0x101E)
0x1800101F CGVER ro — CAN Macro Revision Register (0x101F)
0x18001020 CGINTP R/(W) — CAN global interrupt pending register
{0x18001020+2i} C{i}INTP (i=1..4) — CAN local interrupt pending register {i}
{0x18001040+4i} C1MASKL{i} (i=0..3) — CAN1 address mask register L{i}
{0x18001042+4i} C1MASKH{i} (i=0..3) — CAN1 address mask register H{i}
{0x18001010+0x40*i} C{i}CTRL R/(W) (i=1..3) — CAN{i} control register
{0x18001012+0x40*i} C{i}DEF R/(W) (i=1..3) — CAN{i} definition register
{0x18001014+0x40*i} C{i}LAST ro (i=1..3) — CAN{i} information register
{0x18001016+0x40*i} C{i}ERC ro (i=1..3) — CAN{i} error counter register
{0x18001018+0x40*i} C{i}IE R/(W) (i=1..3) — CAN{i} interrupt enable register
{0x1800101A+0x40*i} C{i}BA ro (i=1..3) — CAN{i} bus active register
{0x1800101C+0x40*i} C{i}BRP (i=1..3) — CAN{i} bit rate prescaler register
{0x1800101D+0x40*i} C{i}DINF ro (i=1..3) — CAN{i} bus diagnostic information register
{0x1800101E+0x40*i} C{i}SYNC (i=1..3) — CAN{i} synchronization control register
{0x18001080+4i} C2MASKL{i} (i=0..3) — CAN2 address mask register L{i}
{0x18001082+4i} C2MASKH{i} (i=0..3) — CAN2 address mask register H{i}
{0x180010C0+4i} C3MASKL{i} (i=0..3) — CAN3 address mask register L{i}
{0x180010C2+4i} C3MASKH{i} (i=0..3) — CAN3 address mask register H{i}
0x18001100 C4MASKL0 — CAN4 address mask register L0
{0x180011C2+4i} C4MASKH{i} (i=0..3) — CAN4 address mask register H{i}
{0x180011C0+4i} C4MASKL{i} (i=1..3) — CAN4 address mask register L{i}
0x180011D0 C4CTRL R/(W) — CAN4 control register
0x180011D2 C4DEF R/(W) — CAN4 definition register
0x180011D4 C4LAST ro — CAN4 information register
0x180011D6 C4ERC ro — CAN4 error counter register
0x180011D8 C4IE R/(W) — CAN4 interrupt enable register
0x180011DA C4BA ro — CAN4 bus active register
0x180011DC C4BRP — CAN4 bit rate prescaler register
0x180011DD C4DINF ro — CAN4 bus diagnostic information register
0x180011DE C4SYNC — CAN4 synchronization control register
